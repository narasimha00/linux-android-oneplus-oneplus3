## backports/Kconfig
```kconfig
config BACKPORT_INTEGRATE
	bool
	def_bool y

config BACKPORT_DIR
	string
	default "backports/"

config BACKPORT_VERSION
	string
	default "v4.2.6-1-0-g90118c7"

config BACKPORT_KERNEL_VERSION
	string
	default "v4.2.6-0-g1c02865"

config BACKPORT_KERNEL_NAME
	string
	default "Linux"

menuconfig BACKPORT_LINUX
	bool "Backport Linux v4.2.6-0-g1c02865 (backports v4.2.6-1-0-g90118c7)"
	default n
	---help---
	  Enabling this will let give you the opportunity to use features and
	  drivers backported from Linux v4.2.6-0-g1c02865
	  on the kernel your are using. This is experimental and you should
	  say no unless you'd like to help test things or want to help debug
	  this should we run into any issues.

if BACKPORT_LINUX

config BACKPORT_KERNEL_3_19
    def_bool y
config BACKPORT_KERNEL_4_0
    def_bool y
config BACKPORT_KERNEL_4_1
    def_bool y
config BACKPORT_KERNEL_4_2
    def_bool y

# this has the configuration for the backport code
source "$BACKPORT_DIR/compat/Kconfig"

# these are copied from the kernel
#source "$BACKPORT_DIR/net/wireless/Kconfig"
#source "$BACKPORT_DIR/net/mac80211/Kconfig"
source "$BACKPORT_DIR/net/bluetooth/Kconfig"
#source "$BACKPORT_DIR/drivers/net/wireless/Kconfig"
#source "$BACKPORT_DIR/drivers/net/ethernet/Kconfig"
#source "$BACKPORT_DIR/drivers/net/usb/Kconfig"

#source "$BACKPORT_DIR/drivers/ssb/Kconfig"
#source "$BACKPORT_DIR/drivers/bcma/Kconfig"

#source "$BACKPORT_DIR/net/nfc/Kconfig"

#source "$BACKPORT_DIR/drivers/media/Kconfig"

#source "$BACKPORT_DIR/net/6lowpan/Kconfig"
#source "$BACKPORT_DIR/net/ieee802154/Kconfig"
#source "$BACKPORT_DIR/net/mac802154/Kconfig"
#source "$BACKPORT_DIR/drivers/net/ieee802154/Kconfig"

#source "$BACKPORT_DIR/drivers/usb/class/Kconfig"

endif # BACKPORT_LINUX
```

## backports/drivers/media/pci/cobalt/Kconfig
```kconfig
config BACKPORT_VIDEO_COBALT
	tristate "Cisco Cobalt support"
	depends on !VIDEO_COBALT
	depends on VIDEO_V4L2 && I2C && BACKPORT_MEDIA_CONTROLLER
	depends on PCI_MSI && MTD_COMPLEX_MAPPINGS && GPIOLIB
	depends on SND
	depends on I2C_ALGOBIT
	select BACKPORT_VIDEO_ADV7604
	select BACKPORT_VIDEO_ADV7511
	select BACKPORT_VIDEO_ADV7842
	select BACKPORT_VIDEOBUF2_DMA_SG
	---help---
	  This is a video4linux driver for the Cisco PCIe Cobalt card.

	  This board is sadly not available outside of Cisco, but it is
	  very useful as an example of a real driver that uses all the
	  latest frameworks and APIs.

	  To compile this driver as a module, choose M here: the
	  module will be called cobalt.
```

## backports/drivers/media/pci/dt3155/Kconfig
```kconfig
config BACKPORT_VIDEO_DT3155
	tristate "DT3155 frame grabber"
	depends on !VIDEO_DT3155
	depends on PCI && BACKPORT_VIDEO_DEV && VIDEO_V4L2
	depends on HAS_DMA
	select BACKPORT_VIDEOBUF2_DMA_CONTIG
	default n
	---help---
	  Enables dt3155 device driver for the DataTranslation DT3155 frame grabber.
	  Say Y here if you have this hardware.
	  In doubt, say N.

	  To compile this driver as a module, choose M here: the
	  module will be called dt3155.
```

## backports/drivers/net/wireless/mediatek/Kconfig
```kconfig
menuconfig BACKPORT_WL_MEDIATEK
	bool "Mediatek Wireless LAN support"
	depends on !WL_MEDIATEK
	---help---
	  Enable community drivers for MediaTek WiFi devices.
	  Those drivers make use of the Linux mac80211 stack.


if BACKPORT_WL_MEDIATEK
source "$BACKPORT_DIR/drivers/net/wireless/mediatek/mt7601u/Kconfig"
endif # BACKPORT_WL_MEDIATEK
```
